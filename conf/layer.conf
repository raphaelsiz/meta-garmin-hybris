## conf/layer.conf
```bitbake
BBPATH .= ":${LAYERDIR}"
BBFILES += "${LAYERDIR}/recipes*/*/*.bb ${LAYERDIR}/recipes*/*/*.bbappend"
BBFILE_COLLECTIONS += "garmin-hybris-layer"
BBFILE_PATTERN_garmin-hybris-layer := "^${LAYERDIR}/"
BBFILE_PRIORITY_garmin-hybris-layer = "7"
LAYERSERIES_COMPAT_garmin-hybris-layer = "honister"
```
